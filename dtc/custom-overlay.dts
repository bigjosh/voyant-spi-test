/dts-v1/;
/plugin/;


/ {
    compatible = "toradex,verdin-imx8mp";
};
    

    // //From main dts
    // &flexspi {
    //     pinctrl-names = "default";
    //     pinctrl-0 = <&pinctrl_flexspi0>;
    // };

	// pinctrl_flexspi0: flexspi0grp {
	// 	fsl,pins =
	// 		<MX8MP_IOMUXC_NAND_ALE__FLEXSPI_A_SCLK		0x1c2>,	/* SODIMM 52 */
	// 		<MX8MP_IOMUXC_NAND_CE0_B__FLEXSPI_A_SS0_B	0x82>,	/* SODIMM 54 */
	// 		<MX8MP_IOMUXC_NAND_DQS__FLEXSPI_A_DQS		0x82>,	/* SODIMM 66 */
	// 		<MX8MP_IOMUXC_NAND_DATA00__FLEXSPI_A_DATA00	0x82>,	/* SODIMM 56 */
	// 		<MX8MP_IOMUXC_NAND_DATA01__FLEXSPI_A_DATA01	0x82>,	/* SODIMM 58 */
	// 		<MX8MP_IOMUXC_NAND_DATA02__FLEXSPI_A_DATA02	0x82>,	/* SODIMM 60 */
	// 		<MX8MP_IOMUXC_NAND_DATA03__FLEXSPI_A_DATA03	0x82>,	/* SODIMM 62 */
	// 		<MX8MP_IOMUXC_NAND_READY_B__GPIO3_IO16		0x82>;	/* SODIMM 64 */
	// };    

    // From: imx8mp.dtsi
    // flexspi: spi@30bb0000 {
    //     compatible = "nxp,imx8mp-fspi";
    //     reg = <0x30bb0000 0x10000>, <0x8000000 0x10000000>;
    //     reg-names = "fspi_base", "fspi_mmap";
    //     interrupts = <GIC_SPI 107 IRQ_TYPE_LEVEL_HIGH>;
    //     clocks = <&clk IMX8MP_CLK_QSPI_ROOT>,
    //             <&clk IMX8MP_CLK_QSPI_ROOT>;
    //     clock-names = "fspi_en", "fspi";
    //     assigned-clock-rates = <80000000>;
    //     assigned-clocks = <&clk IMX8MP_CLK_QSPI>;
    //     #address-cells = <1>;
    //     #size-cells = <0>;
    //     status = "disabled";
    // };

/ {
    fragment@0 {
        target = <&flexspi>;
        __overlay__ {
            #address-cells = <1>;
            #size-cells = <0>;
            status = "okay";

            spidev0: spidev@0 {
                // compatible = "spidev";       .. does not seem to create the deice. silienty fails.
                // Use compatible "rohm,dh2228fv" to bind spidev driver insead as suggested by grok?
                compatible = "jedec,spi-nor";
                // compatible = "rohm,dh2228fv";          // Should match with spidev?
                reg = <0>;
                spi-max-frequency = <80000000>;
                //spi-max-frequency = <1000000>;          // Slow it down to 1MHz for testing (logic only 50M samples/sec)
                //spi-tx-bus-width = <4>;                   // TODO: Test if this puts us into 4-4-4 mode
                spi-tx-bus-width = <1>;                   // 1-1-4 mode
                spi-rx-bus-width = <4>;
            };
        };
    };
};

